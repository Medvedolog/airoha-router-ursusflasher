## ursusboot/configs/an7581_nokia_xg-040g-md_FUDAN1_defconfig
```kconfig
CONFIG_ARM=y
CONFIG_POSITION_INDEPENDENT=y
CONFIG_ARCH_AIROHA=y
CONFIG_TARGET_AN7581=y
CONFIG_TEXT_BASE=0x81e00000
CONFIG_SYS_MALLOC_F_LEN=0x4000
CONFIG_NR_DRAM_BANKS=1
CONFIG_DM_GPIO=y
CONFIG_DEFAULT_DEVICE_TREE="airoha/an7581-nokia-xg-040g-md"
CONFIG_SYS_LOAD_ADDR=0x81800000
CONFIG_BUILD_TARGET="u-boot.bin"
# CONFIG_EFI_LOADER is not set
CONFIG_FIT=y
CONFIG_FIT_VERBOSE=y
CONFIG_BOOTDELAY=-2
CONFIG_AUTOBOOT_KEYED=y
CONFIG_DEFAULT_FDT_FILE="airoha/an7581-nokia-xg-040g-md.dtb"
CONFIG_CONSOLE_RECORD=y
CONFIG_SYS_PBSIZE=1049
CONFIG_LOGLEVEL=9
CONFIG_SYS_CONSOLE_IS_IN_ENV=y
CONFIG_LOG=y
# CONFIG_DISPLAY_BOARDINFO is not set
CONFIG_HUSH_PARSER=y
CONFIG_SYS_PROMPT="AN7581> "
CONFIG_SYS_MAXARGS=8
CONFIG_CMD_LICENSE=y
CONFIG_CMD_ASKENV=y
CONFIG_CMD_ERASEENV=y
CONFIG_CMD_ENV_FLAGS=y
CONFIG_CMD_STRINGS=y
CONFIG_CMD_DM=y
CONFIG_CMD_GPIO=y
CONFIG_CMD_GPT=y
CONFIG_CMD_MTD=y
CONFIG_CMD_MTD_MARKBAD=y
CONFIG_CMD_MTD_NAND_WRITE_TEST=y
CONFIG_CMD_MTD_NAND_READ_TEST=y
CONFIG_CMD_PART=y
CONFIG_CMD_DHCP=y
CONFIG_CMD_DNS=y
CONFIG_CMD_MII=y
CONFIG_CMD_PING=y
CONFIG_CMD_SNTP=y
CONFIG_CMD_WGET=y
CONFIG_CMD_PXE=y
CONFIG_CMD_CACHE=y
CONFIG_CMD_UUID=y
CONFIG_CMD_HASH=y
CONFIG_CMD_SMC=y
CONFIG_CMD_UBI=y
CONFIG_CMD_UBI_RENAME=y
CONFIG_OF_UPSTREAM=y
CONFIG_ENV_OVERWRITE=y
# CONFIG_ENV_IS_IN_MTD is not set
CONFIG_ENV_IS_IN_UBI=y
CONFIG_ENV_REDUNDANT=y
CONFIG_ENV_UBI_PART="ubi"
CONFIG_ENV_UBI_VOLUME="ubootenv"
CONFIG_ENV_UBI_VOLUME_REDUND="ubootenv2"
CONFIG_ENV_RELOC_GD_ENV_ADDR=y
CONFIG_ENV_USE_DEFAULT_ENV_TEXT_FILE=y
CONFIG_ENV_DEFAULT_ENV_TEXT_FILE="defenvs/an7581_nokia_xg-040g-md_env"
CONFIG_ENV_VARS_UBOOT_RUNTIME_CONFIG=y
CONFIG_VERSION_VARIABLE=y
CONFIG_NET_LWIP=y
CONFIG_NET_RANDOM_ETHADDR=y
CONFIG_SYS_RX_ETH_BUFFER=8
CONFIG_BUTTON=y
CONFIG_BUTTON_GPIO=y
CONFIG_CLK=y
CONFIG_DMA=y
CONFIG_GPIO_HOG=y
CONFIG_LED=y
CONFIG_LED_BLINK=y
CONFIG_LED_GPIO=y
# CONFIG_MMC is not set
CONFIG_MTD=y
CONFIG_DM_MTD=y
CONFIG_MTD_CONCAT=y
CONFIG_MTD_SPI_NAND=y
CONFIG_SPI_FLASH=y
CONFIG_SPI_FLASH_EON=y
CONFIG_SPI_FLASH_GIGADEVICE=y
CONFIG_SPI_FLASH_ISSI=y
CONFIG_SPI_FLASH_MACRONIX=y
CONFIG_SPI_FLASH_SPANSION=y
CONFIG_SPI_FLASH_STMICRO=y
CONFIG_SPI_FLASH_WINBOND=y
CONFIG_SPI_FLASH_MTD=y
CONFIG_UBI_BLOCK=y
CONFIG_DM_MDIO=y
CONFIG_PCS_AIROHA_AN7581=y
CONFIG_AIROHA_ETH=y
CONFIG_PHY_ANEG_TIMEOUT=10000
CONFIG_PHY_ETHERNET_ID=y
CONFIG_PHY=y
CONFIG_PINCTRL=y
CONFIG_PINCTRL_AIROHA_AN7581=y
CONFIG_POWER_DOMAIN=y
CONFIG_DM_REGULATOR=y
CONFIG_DM_REGULATOR_FIXED=y
CONFIG_RAM=y
CONFIG_DM_SERIAL=y
CONFIG_SYS_NS16550=y
CONFIG_SPI=y
CONFIG_DM_SPI=y
CONFIG_AIROHA_SNFI_SPI=y
# CONFIG_UBIFS_SILENCE_MSG is not set
CONFIG_SHA512=y
```

## ursusboot/configs/an7583_nokia_xg-040g-mf_MF2_RAM_defconfig
```kconfig
CONFIG_ARM=y
CONFIG_ARCH_AIROHA=y
CONFIG_POSITION_INDEPENDENT=y
CONFIG_BOOTDELAY=0
CONFIG_AUTOBOOT_KEYED=y
CONFIG_TARGET_AN7583=y
CONFIG_TEXT_BASE=0x81e00000
CONFIG_SYS_MALLOC_F_LEN=0x4000
CONFIG_NR_DRAM_BANKS=1
CONFIG_DM_GPIO=y
CONFIG_DEFAULT_DEVICE_TREE="an7583-nokia-xg-040g-mf"
CONFIG_SYS_LOAD_ADDR=0x81800000
CONFIG_BUILD_TARGET="u-boot.bin"
# CONFIG_EFI_LOADER is not set
CONFIG_FIT=y
CONFIG_FIT_VERBOSE=y
CONFIG_DEFAULT_FDT_FILE="an7583-nokia-xg-040g-mf.dtb"
CONFIG_LOGLEVEL=9
CONFIG_LOG=y
CONFIG_CONSOLE_RECORD=y
CONFIG_SYS_PBSIZE=1049
CONFIG_SYS_CONSOLE_IS_IN_ENV=y
# CONFIG_DISPLAY_BOARDINFO is not set
CONFIG_HUSH_PARSER=y
CONFIG_SYS_PROMPT="UrsusBoot-MF2> "
CONFIG_SYS_MAXARGS=8
CONFIG_CMD_CPU=y
CONFIG_CMD_LICENSE=y
CONFIG_CMD_ASKENV=y
CONFIG_CMD_ENV_FLAGS=y
CONFIG_CMD_RNG=y
CONFIG_CMD_STRINGS=y
CONFIG_CMD_DM=y
CONFIG_CMD_GPIO=y
CONFIG_CMD_GPT=y
CONFIG_CMD_PART=y
CONFIG_CMD_TFTPSRV=y
CONFIG_CMD_RARP=y
CONFIG_CMD_CDP=y
CONFIG_CMD_SNTP=y
CONFIG_CMD_LINK_LOCAL=y
CONFIG_CMD_DHCP=y
CONFIG_CMD_DNS=y
CONFIG_CMD_PING=y
CONFIG_CMD_CACHE=y
CONFIG_CMD_UUID=y
CONFIG_CMD_HASH=y
CONFIG_CMD_SMC=y
CONFIG_ENV_USE_DEFAULT_ENV_TEXT_FILE=y
CONFIG_ENV_DEFAULT_ENV_TEXT_FILE="defenvs/an7583_nokia_xg-040g-mf_env"
CONFIG_ENV_VARS_UBOOT_RUNTIME_CONFIG=y
CONFIG_ENV_IS_NOWHERE=y
# CONFIG_ENV_IS_IN_MTD is not set
# CONFIG_ENV_IS_IN_UBI is not set
# CONFIG_MMC is not set
CONFIG_MTD=y
CONFIG_DM_MTD=y
CONFIG_MTD_SPI_NAND=y
CONFIG_MTD_UBI=y
CONFIG_MTD_UBI_MODULE=y
CONFIG_MTD_UBI_WL_THRESHOLD=4096
CONFIG_MTD_UBI_BEB_LIMIT=20
# CONFIG_MTD_UBI_FASTMAP is not set
CONFIG_UBI_BLOCK=y
# CONFIG_UBIFS_SILENCE_MSG is not set
# CONFIG_UBIFS_SILENCE_DEBUG_DUMP is not set
CONFIG_VERSION_VARIABLE=y
CONFIG_NET_LWIP=y
CONFIG_NETCONSOLE=y
CONFIG_USE_IPADDR=y
CONFIG_IPADDR="192.168.1.1"
CONFIG_USE_SERVERIP=y
CONFIG_SERVERIP="192.168.1.254"
CONFIG_NET_RANDOM_ETHADDR=y
CONFIG_BUTTON=y
CONFIG_BUTTON_GPIO=y
CONFIG_SYS_RX_ETH_BUFFER=8
CONFIG_REGMAP=y
CONFIG_SYSCON=y
CONFIG_CLK=y
CONFIG_DMA=y
CONFIG_GPIO_HOG=y
CONFIG_LED=y
CONFIG_LED_BLINK=y
CONFIG_LED_GPIO=y
CONFIG_SPI_FLASH=y
CONFIG_SPI_FLASH_EON=y
CONFIG_SPI_FLASH_GIGADEVICE=y
CONFIG_SPI_FLASH_ISSI=y
CONFIG_SPI_FLASH_MACRONIX=y
CONFIG_SPI_FLASH_SPANSION=y
CONFIG_SPI_FLASH_STMICRO=y
CONFIG_SPI_FLASH_WINBOND=y
CONFIG_SPI_FLASH_MTD=y
CONFIG_AIROHA_ETH=y
CONFIG_DM_MDIO=y
CONFIG_CMD_MII=y
CONFIG_CMD_MDIO=y
CONFIG_PCS_AIROHA_AN7583=y
CONFIG_PHY=y
CONFIG_PINCTRL=y
CONFIG_PINCTRL_AIROHA_AN7583=y
CONFIG_POWER_DOMAIN=y
CONFIG_DM_REGULATOR=y
CONFIG_DM_REGULATOR_FIXED=y
CONFIG_RAM=y
CONFIG_DM_SERIAL=y
CONFIG_SYS_NS16550=y
CONFIG_SPI=y
CONFIG_DM_SPI=y
CONFIG_AIROHA_SNFI_SPI=y
CONFIG_SHA512=y
CONFIG_USE_DEFAULT_ENV_FILE=y
CONFIG_DEFAULT_ENV_FILE="defenvs/an7583_nokia_xg-040g-mf_env"
CONFIG_PHY_ANEG_TIMEOUT=10000
CONFIG_PHY_ETHERNET_ID=y
CONFIG_CMD_WGET=y
CONFIG_CMD_TFTPBOOT=y
# CONFIG_CMD_MTD is not set
# CONFIG_CMD_MTD_MARKBAD is not set
# CONFIG_CMD_MTD_NAND_READ_TEST is not set
# CONFIG_CMD_MTD_NAND_WRITE_TEST is not set
# CONFIG_CMD_UBI is not set
# CONFIG_CMD_UBI_RENAME is not set
# CONFIG_CMD_ERASEENV is not set
# CONFIG_CMD_NAND is not set
# CONFIG_CMD_SF is not set
# CONFIG_CMD_PXE is not set
```
